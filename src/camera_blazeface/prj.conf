## CMakeLists.txt
```
cmake_minimum_required(VERSION 3.20.0)

list(APPEND DTS_ROOT ${CMAKE_CURRENT_SOURCE_DIR})

find_package(Zephyr REQUIRED HINTS $ENV{ZEPHYR_BASE})
project(camera_blazeface)

target_include_directories(app PRIVATE
    ${ZEPHYR_BASE}/drivers/video
    ${CMAKE_CURRENT_SOURCE_DIR}/drivers/video
    ${CMAKE_CURRENT_SOURCE_DIR}/src/ai
)

target_sources(app PRIVATE
    src/main.c
    drivers/video/gc0308.c
    src/ai/blazeface_detector.cpp
)

include(${CMAKE_CURRENT_SOURCE_DIR}/tflm.cmake)
```

## prj.conf
```kconfig
CONFIG_LOG=y
CONFIG_LOG_MODE_IMMEDIATE=y
CONFIG_LOG_DEFAULT_LEVEL=3
CONFIG_CONSOLE=y
CONFIG_UART_CONSOLE=y
CONFIG_SERIAL=y
CONFIG_GPIO=y
CONFIG_I2C=y
CONFIG_SPI=y
CONFIG_REGULATOR=y

# C++ Support for TensorFlow Lite Micro
CONFIG_CPP=y
CONFIG_STD_CPP17=y
CONFIG_GLIBCXX_LIBCPP=y

# External PSRAM (M5Stack CoreS3 has Quad SPI PSRAM)
CONFIG_ESP_SPIRAM=y
CONFIG_SPIRAM_MODE_QUAD=y
CONFIG_SPIRAM_SPEED_80M=y
CONFIG_SPIRAM_TYPE_ESPPSRAM64=y
CONFIG_ESP_SPIRAM_SIZE=8388608
CONFIG_ESP_SPIRAM_MEMTEST=y

# Video Subsystem (GC0308 DVP Camera)
CONFIG_VIDEO=y
CONFIG_VIDEO_LOG_LEVEL_INF=y
CONFIG_VIDEO_INIT_PRIORITY=90
CONFIG_VIDEO_BUFFER_POOL_HEAP_SIZE=160000
CONFIG_VIDEO_BUFFER_POOL_NUM_MAX=1
CONFIG_VIDEO_BUFFER_POOL_ALIGN=32

# ESP32-S3 DMA and DVP
CONFIG_DMA=y
CONFIG_DMA_ESP32=y
CONFIG_DMA_ESP32_MAX_DESCRIPTOR_NUM=128

# Display Subsystem (ILI9342C SPI 40MHz)
CONFIG_DISPLAY=y
CONFIG_MIPI_DBI=y
CONFIG_ILI9342C=y
CONFIG_DISPLAY_LOG_LEVEL_INF=y

# Performance & Cache Optimizations
CONFIG_SPEED_OPTIMIZATIONS=y
CONFIG_ESP32S3_DATA_CACHE_64KB=y
CONFIG_ESP32S3_INSTRUCTION_CACHE_32KB=y

# Thread stack sizes
CONFIG_MAIN_STACK_SIZE=8192

# Boot delay (3 seconds) to allow PC USB host enumeration and terminal reconnection
CONFIG_BOOT_DELAY=3000
```

## src/main.c
```c
/*
 * Copyright (c) 2026
 * SPDX-License-Identifier: Apache-2.0
 */

#include <zephyr/kernel.h>
#include <zephyr/device.h>
#include <zephyr/drivers/display.h>
#include <zephyr/drivers/video.h>
#include <zephyr/video/video.h>
#include <zephyr/logging/log.h>
#include <zephyr/version.h>
#include <soc/lcd_cam_struct.h>
#include <soc/gpio_struct.h>
#include <string.h>

#include "blazeface_detector.h"
#include "zephyr_logo.h"

LOG_MODULE_REGISTER(camera_blazeface, LOG_LEVEL_INF);

#define LCD_WIDTH   320
#define LCD_HEIGHT  240
#define FRAME_SIZE  (LCD_WIDTH * LCD_HEIGHT * 2) /* 153,600 bytes for RGB565 */

/* Color constants in SPI byte-swapped format (Big Endian over SPI) */
#define COLOR_GREEN 0xE007 /* 0x07E0 swapped */
#define COLOR_RED   0x00F8 /* 0xF800 swapped */
#define COLOR_CYAN  0xFF07 /* 0x07FF swapped */

/* Line buffer for screen clearing */
static uint16_t line_buf[LCD_WIDTH];

/* Snapshot buffer in 8MB PSRAM for asynchronous AI inference */
static uint16_t s_ai_frame[LCD_WIDTH * LCD_HEIGHT] __attribute__((section(".ext_ram.bss")));

/* Thread synchronization */
static K_SEM_DEFINE(s_ai_sem, 0, 1);
static K_MUTEX_DEFINE(s_box_mutex);

static volatile bool s_ai_busy = false;
static blazeface_box_t s_detected_boxes[MAX_DETECTED_FACES];
static int s_detected_box_count = 0;
static uint32_t s_last_infer_time_ms = 0;

/* AI Worker Thread Definition */
#define AI_THREAD_STACK_SIZE 8192
#define AI_THREAD_PRIORITY   11
K_THREAD_STACK_DEFINE(s_ai_stack, AI_THREAD_STACK_SIZE);
static struct k_thread s_ai_thread_data;

static void clear_screen_color(const struct device *display_dev, uint16_t rgb565_color)
{
	uint16_t be_color = (rgb565_color >> 8) | ((rgb565_color & 0xff) << 8);
	for (size_t i = 0; i < LCD_WIDTH; i++) {
		line_buf[i] = be_color;
	}

	struct display_buffer_descriptor desc = {
		.buf_size = sizeof(line_buf),
		.width = LCD_WIDTH,
		.height = 1,
		.pitch = LCD_WIDTH,
	};

	for (uint16_t y = 0; y < LCD_HEIGHT; y++) {
		display_write(display_dev, 0, y, &desc, line_buf);
	}
}

static void draw_box(uint16_t *buf, int x1, int y1, int x2, int y2, uint16_t color, int thickness)
{
	if (x1 < 0) x1 = 0;
	if (y1 < 0) y1 = 0;
	if (x2 >= LCD_WIDTH) x2 = LCD_WIDTH - 1;
	if (y2 >= LCD_HEIGHT) y2 = LCD_HEIGHT - 1;
	if (x1 >= x2 || y1 >= y2) return;

	/* Horizontal top and bottom lines */
	for (int t = 0; t < thickness; t++) {
		int top = y1 + t;
		int bot = y2 - t;
		if (top < LCD_HEIGHT) {
			for (int x = x1; x <= x2; x++) buf[top * LCD_WIDTH + x] = color;
		}
		if (bot >= 0) {
			for (int x = x1; x <= x2; x++) buf[bot * LCD_WIDTH + x] = color;
		}
	}

	/* Vertical left and right lines */
	for (int t = 0; t < thickness; t++) {
		int left = x1 + t;
		int right = x2 - t;
		if (left < LCD_WIDTH) {
			for (int y = y1; y <= y2; y++) buf[y * LCD_WIDTH + left] = color;
		}
		if (right >= 0) {
			for (int y = y1; y <= y2; y++) buf[y * LCD_WIDTH + right] = color;
		}
	}
}

static void draw_zephyr_logo(uint16_t *frame_pixels, int start_x, int start_y)
{
	for (int y = 0; y < ZEPHYR_LOGO_H; y++) {
		int py = start_y + y;
		if (py < 0 || py >= LCD_HEIGHT) continue;

		for (int x = 0; x < ZEPHYR_LOGO_W; x++) {
			int px = start_x + x;
			if (px < 0 || px >= LCD_WIDTH) continue;

			const zephyr_logo_pixel_t *lp = &g_zephyr_logo[y * ZEPHYR_LOGO_W + x];
			if (lp->a == 0) continue; /* Fully transparent */

			uint8_t *p = (uint8_t *)&frame_pixels[py * LCD_WIDTH + px];
			uint8_t b0 = p[0];
			uint8_t b1 = p[1];

			/* Extract camera RGB (0..255) */
			uint32_t cam_r = ((b0 >> 3) & 0x1F) * 255 / 31;
			uint32_t cam_g = (((b0 & 0x07) << 3) | ((b1 >> 5) & 0x07)) * 255 / 63;
			uint32_t cam_b = (b1 & 0x1F) * 255 / 31;

			/* Alpha blend */
			uint32_t a = lp->a;
			uint32_t inv_a = 255 - a;
			uint32_t out_r = (lp->r * a + cam_r * inv_a) / 255;
			uint32_t out_g = (lp->g * a + cam_g * inv_a) / 255;
			uint32_t out_b = (lp->b * a + cam_b * inv_a) / 255;

			/* Repack into RGB565 byte-swapped format */
			uint32_t r5 = (out_r * 31 + 127) / 255;
			uint32_t g6 = (out_g * 63 + 127) / 255;
			uint32_t b5 = (out_b * 31 + 127) / 255;

			p[0] = ((r5 & 0x1F) << 3) | ((g6 >> 3) & 0x07);
			p[1] = ((g6 & 0x07) << 5) | (b5 & 0x1F);
		}
	}
}

/* AI Inference Worker Thread */
static void ai_thread_entry(void *p1, void *p2, void *p3)
{
	ARG_UNUSED(p1);
	ARG_UNUSED(p2);
	ARG_UNUSED(p3);

	LOG_INF("[AI_THREAD] Background AI inference thread started");

	blazeface_box_t local_boxes[MAX_DETECTED_FACES];

	while (1) {
		k_sem_take(&s_ai_sem, K_FOREVER);

		uint32_t infer_ms = 0;
		int num_faces = blazeface_detector_run(s_ai_frame, local_boxes, MAX_DETECTED_FACES, &infer_ms);

		k_mutex_lock(&s_box_mutex, K_FOREVER);
		s_detected_box_count = (num_faces > 0) ? num_faces : 0;
		for (int i = 0; i < s_detected_box_count; i++) {
			s_detected_boxes[i] = local_boxes[i];
		}
		s_last_infer_time_ms = infer_ms;
		k_mutex_unlock(&s_box_mutex);

		s_ai_busy = false;
	}
}

int main(void)
{
	int ret;
	const struct device *const display_dev = DEVICE_DT_GET(DT_CHOSEN(zephyr_display));
	const struct device *const camera_dev = DEVICE_DT_GET(DT_CHOSEN(zephyr_camera));

	LOG_INF("==================================================");
	LOG_INF(" M5Stack CoreS3 BlazeFace AI Face Detection       ");
	LOG_INF(" Zephyr OS Build: %s", KERNEL_VERSION_STRING);
	LOG_INF(" Model: BlazeFace INT8 (128x128 SSD Face Detector)");
	LOG_INF("==================================================");

	/* 1. Initialize Display (ILI9342C) */
	if (!device_is_ready(display_dev)) {
		LOG_ERR("Display device (%s) not ready!", display_dev->name);
		return -ENODEV;
	}
	LOG_INF("Display ready: %s", display_dev->name);
	printk("[MAIN] Turning on display blanking off...\n");
	display_blanking_off(display_dev);
	printk("[MAIN] Clearing screen to blue...\n");
	clear_screen_color(display_dev, 0x001F); /* Blue */
	printk("[MAIN] Screen cleared. Sleeping 300ms...\n");
	k_msleep(300);

	/* 2. Initialize BlazeFace Detector */
	printk("[MAIN] Initializing BlazeFace Detector...\n");
	ret = blazeface_detector_init();
	printk("[MAIN] blazeface_detector_init returned: %d\n", ret);
	if (ret < 0) {
		LOG_ERR("Failed to initialize BlazeFace Detector: %d", ret);
		return ret;
	}

	/* 3. Start AI Background Worker Thread */
	k_thread_create(&s_ai_thread_data, s_ai_stack,
			K_THREAD_STACK_SIZEOF(s_ai_stack),
			ai_thread_entry, NULL, NULL, NULL,
			AI_THREAD_PRIORITY, 0, K_NO_WAIT);

	/* 4. Initialize Camera Interface (GC0308) */
	if (!device_is_ready(camera_dev)) {
		LOG_ERR("Camera device (%s) not ready!", camera_dev->name);
		return -ENODEV;
	}
	LOG_INF("Camera ready: %s", camera_dev->name);

	struct video_format fmt = {
		.pixelformat = VIDEO_PIX_FMT_RGB565,
		.width = LCD_WIDTH,
		.height = LCD_HEIGHT,
		.pitch = LCD_WIDTH * 2,
	};
	ret = video_set_format(camera_dev, &fmt);
	if (ret < 0) {
		LOG_ERR("Failed to set video format: %d", ret);
		return ret;
	}

	/* Allocate Video Buffer */
	struct video_buffer *vbuf = video_buffer_aligned_alloc(FRAME_SIZE, 32, K_NO_WAIT);
	if (vbuf == NULL) {
		LOG_ERR("Failed to allocate video buffer!");
		return -ENOMEM;
	}
	vbuf->type = VIDEO_BUF_TYPE_OUTPUT;
	vbuf->bytesused = FRAME_SIZE;
	ret = video_enqueue(camera_dev, vbuf);
	if (ret < 0) {
		LOG_ERR("Failed to enqueue buffer: %d", ret);
		return ret;
	}

	ret = video_stream_start(camera_dev, VIDEO_BUF_TYPE_OUTPUT);
	if (ret < 0) {
		LOG_ERR("Failed to start stream: %d", ret);
		return ret;
	}
	LOG_INF("Video stream started successfully! Starting live preview & AI loop...");
	LCD_CAM.lc_dma_int_ena.cam_vsync_int_ena = 1;

	/* 5. Live Preview & AI Trigger Loop */
	uint32_t frame_count = 0;
	uint32_t last_report_time = k_uptime_get_32();

	while (1) {
		struct video_buffer *rx_buf = NULL;
		ret = video_dequeue(camera_dev, &rx_buf, K_MSEC(1000));
		if (ret < 0) {
			continue;
		}

		uint16_t *frame_pixels = (uint16_t *)rx_buf->buffer;

		/* Asynchronously trigger AI thread if idle */
		if (!s_ai_busy) {
			memcpy(s_ai_frame, frame_pixels, FRAME_SIZE);
			s_ai_busy = true;
			k_sem_give(&s_ai_sem);
		}

		/* Overlay latest detected bounding boxes */
		k_mutex_lock(&s_box_mutex, K_FOREVER);
		int box_count = s_detected_box_count;
		for (int i = 0; i < box_count; i++) {
			blazeface_box_t *box = &s_detected_boxes[i];
			draw_box(frame_pixels, box->x1, box->y1, box->x2, box->y2, COLOR_GREEN, 3);
		}
		uint32_t infer_ms = s_last_infer_time_ms;
		k_mutex_unlock(&s_box_mutex);

		/* Overlay Zephyr Kite Logo in top-right corner */
		draw_zephyr_logo(frame_pixels, LCD_WIDTH - ZEPHYR_LOGO_W - 8, 8);

		/* Render frame onto ILI9342C display */
		struct display_buffer_descriptor desc = {
			.buf_size = rx_buf->bytesused,
			.width = LCD_WIDTH,
			.height = LCD_HEIGHT,
			.pitch = LCD_WIDTH,
		};
		display_write(display_dev, 0, 0, &desc, rx_buf->buffer);

		/* Re-enqueue the buffer for next frame */
		video_enqueue(camera_dev, rx_buf);

		frame_count++;
		uint32_t now = k_uptime_get_32();
		if (now - last_report_time >= 2000) {
			uint32_t elapsed_ms = now - last_report_time;
			uint32_t fps_x10 = (frame_count * 10000) / elapsed_ms;
			printk("[APP] Preview: %u frames (~%u.%u FPS) | Faces: %d | AI Infer: %u ms\n",
				frame_count, fps_x10 / 10, fps_x10 % 10, box_count, infer_ms);
			frame_count = 0;
			last_report_time = now;
		}
	}

	return 0;
}
```

## src/zephyr_logo.h
```c
/* Auto-generated Zephyr Kite Logo Data (48x27 RGBA) */
#ifndef ZEPHYR_LOGO_H_
#define ZEPHYR_LOGO_H_

#include <stdint.h>

#define ZEPHYR_LOGO_W 48
#define ZEPHYR_LOGO_H 27

typedef struct {
    uint8_t r, g, b, a;
} zephyr_logo_pixel_t;

static const zephyr_logo_pixel_t g_zephyr_logo[1296] = {
    {0,0,0,0}, {0,0,0,0}, {0,0,0,0}, {0,0,0,0}, {0,0,0,0}, {0,0,0,0}, {0,0,0,0}, {0,0,0,0}, {0,0,0,0}, {0,0,0,0}, {0,0,0,0}, {0,0,0,0}, {0,0,0,0}, {0,0,0,0}, {0,0,0,0}, {0,0,0,0}, {0,0,0,0}, {0,0,0,0}, {0,0,0,0}, {0,0,0,0}, {0,0,0,0}, {0,0,0,0}, {0,0,0,0}, {0,0,0,0}, {0,0,0,0}, {0,0,0,0}, {0,0,0,0}, {0,0,0,0}, {0,0,0,0}, {127,255,255,2}, {2,0,0,0}, {59,176,249,175}, {149,222,255,248}, {194,235,250,243}, {177,228,250,246}, {178,229,249,246}, {178,228,249,246}, {174,224,247,246}, {168,220,246,246}, {163,216,244,246}, {159,213,243,246}, {154,209,241,246}, {150,206,239,246}, {146,203,237,246}, {139,199,235,246}, {139,195,233,245}, {131,194,236,246}, {61,180,245,219},
    {0,0,0,0}, {0,0,0,0}, {0,0,0,0}, {0,0,0,0}, {0,0,0,0}, {0,0,0,0}, {0,0,0,0}, {0,0,0,0}, {0,0,0,0}, {0,0,0,0}, {0,0,0,0}, {0,0,0,0}, {0,0,0,0}, {0,0,0,0}, {0,0,0,0}, {0,0,0,0}, {0,0,0,0}, {0,0,0,0}, {0,0,0,0}, {0,0,0,0}, {0,0,0,0}, {0,0,0,0}, {0,0,0,0}, {0,0,0,0}, {0,0,0,0}, {0,0,0,0}, {0,0,0,0}, {0,0,0,0}, {0,255,255,1}, {0,0,0,0}, {85,170,244,24}, {27,157,249,243}, {31,162,253,255}, {121,200,247,254}, {185,233,251,255}, {175,228,251,255}, {168,222,248,255}, {164,219,247,255}, {159,215,245,255}, {154,211,243,255}, {149,207,241,255}, {145,204,239,255}, {140,200,237,255}, {134,196,236,255}, {133,193,233,255}, {127,188,229,255}, {47,174,250,255}, {14,166,253,228},
    {0,0,0,0}, {0,0,0,0}, {0,0,0,0}, {0,0,0,0}, {0,0,0,0}, {0,0,0,0}, {0,0,0,0}, {0,0,0,0}, {0,0,0,0}, {0,0,0,0}, {0,0,0,0}, {0,0,0,0}, {0,0,0,0}, {0,0,0,0}, {0,0,0,0}, {0,0,0,0}, {0,0,0,0}, {0,0,0,0}, {0,0,0,0}, {0,0,0,0}, {0,0,0,0}, {0,0,0,0}, {0,0,0,0}, {0,0,0,0}, {0,0,0,0}, {0,0,0,0}, {0,0,0,0}, {0,0,0,0}, {63,127,255,4}, {0,0,255,1}, {56,163,246,95}, {40,164,255,255}, {32,152,246,251}, {25,148,246,254}, {83,177,245,253}, {161,216,245,253}, {165,217,243,255}, {153,209,241,255}, {149,206,239,255}, {145,203,237,255}, {140,199,235,255}, {135,195,234,255}, {129,191,232,255}, {129,189,229,255}, {119,183,227,254}, {46,165,244,251}, {15,161,255,255}, {34,161,248,227},
    {0,0,0,0}, {0,0,0,0}, {0,0,0,0}, {0,0,0,0}, {0,0,0,0}, {0,0,0,0}, {0,0,0,0}, {0,0,0,0}, {0,0,0,0}, {0,0,0,0}, {0,0,0,0}, {0,0,0,0}, {0,0,0,0}, {0,0,0,0}, {0,0,0,0}, {0,0,0,0}, {0,0,0,0}, {0,0,0,0}, {0,0,0,0}, {0,0,0,0}, {0,0,0,0}, {0,0,0,0}, {0,0,0,0}, {0,0,0,0}, {0,0,0,0}, {0,0,0,0}, {0,0,0,0}, {0,0,0,0}, {0,85,255,3}, {0,0,0,0}, {53,153,244,175}, {45,156,255,254}, {44,148,244,251}, {45,148,245,255}, {34,143,245,255}, {58,156,244,253}, {131,195,240,253}, {153,208,237,255}, {141,200,237,255}, {136,196,234,255}, {132,193,232,255}, {126,189,231,255}, {126,186,228,255}, {113,180,227,254}, {48,160,243,253}, {26,153,248,254}, {36,157,252,255}, {41,156,247,227},
    {0,0,0,0}, {0,0,0,0}, {0,0,0,0}, {0,0,0,0}, {0,0,0,0}, {0,0,0,0}, {0,0,0,0}, {0,0,0,0}, {0,0,0,0}, {0,0,0,0}, {0,0,0,0}, {0,0,0,0}, {0,0,0,0}, {0,0,0,0}, {0,0,0,0}, {0,0,0,0}, {0,0,0,0}, {0,0,0,0}, {0,0,0,0}, {0,0,0,0}, {0,0,0,0}, {0,0,0,0}, {0,0,0,0}, {0,0,0,0}, {0,0,0,0}, {0,0,0,0}, {0,0,0,0}, {0,255,255,1}, {0,0,0,0}, {102,165,242,20}, {56,144,243,240}, {52,144,246,255}, {51,142,241,254}, {51,142,242,255}, {54,144,242,255}, {47,140,243,255}, {50,141,242,254}, {101,173,238,252}, {136,196,232,254}, {130,191,231,255}, {122,185,229,255}, {122,184,226,255}, {108,176,227,254}, {51,154,241,254}, {36,148,247,255}, {44,148,244,254}, {43,150,250,255}, {50,149,244,227},
    {0,0,0,0}, {0,0,0,0}, {0,0,0,0}, {0,0,0,0}, {0,0,0,0}, {0,0,0,0}, {0,0,0,0}, {0,0,0,0}, {0,0,0,0}, {0,0,0,0}, {0,0,0,0}, {0,0,0,0}, {0,0,0,0}, {0,0,0,0}, {0,0,0,0}, {0,0,0,0}, {0,0,0,0}, {0,0,0,0}, {0,0,0,0}, {0,0,0,0}, {0,0,0,0}, {0,0,0,0}, {0,0,0,0}, {0,0,0,0}, {0,0,0,0}, {0,0,0,0}, {0,0,0,0}, {63,127,255,4}, {0,0,255,1}, {77,148,240,89}, {65,146,255,255}, {59,136,239,252}, {60,137,240,255}, {61,137,240,255}, {60,137,240,255}, {61,138,240,255}, {59,138,241,255}, {54,134,241,255}, {80,153,237,253}, {115,180,228,253}, {119,184,224,255}, {101,171,227,253}, {54,147,241,254}, {46,143,244,255}, {52,144,242,255}, {52,142,241,254}, {53,144,247,255}, {59,144,242,227},
    {0,0,0,0}, {0,0,0,0}, {0,0,0,0}, {0,0,0,0}, {0,0,0,0}, {0,0,0,0}, {0,0,0,0}, {0,0,0,0}, {0,0,0,0}, {0,0,0,0}, {0,0,0,0}, {0,0,0,0}, {0,0,0,0}, {0,0,0,0}, {0,0,0,0}, {0,0,0,0}, {0,0,0,0}, {0,0,0,0}, {0,0,0,0}, {0,0,0,0}, {0,0,0,0}, {0,0,0,0}, {0,0,0,0}, {0,0,0,0}, {0,0,0,0}, {0,0,0,0}, {0,0,0,0}, {85,85,255,3}, {0,0,0,0}, {77,137,238,171}, {73,140,252,254}, {69,132,238,251}, {69,132,238,255}, {69,132,238,255}, {69,132,238,255}, {68,132,239,255}, {68,132,238,255}, {70,133,238,255}, {63,128,239,255}, {73,139,237,254}, {95,160,229,252}, {61,144,240,254}, {54,137,242,255}, {60,139,241,255}, {60,137,241,255}, {61,136,239,254}, {63,137,245,255}, {70,138,240,227},
    {0,0,0,0}, {0,0,0,0}, {0,0,0,0}, {0,0,0,0}, {0,0,0,0}, {0,0,0,0}, {0,0,0,0}, {0,0,0,0}, {0,0,0,0}, {0,0,0,0}, {0,0,0,0}, {0,0,0,0}, {0,0,0,0}, {0,0,0,0}, {0,0,0,0}, {0,0,0,0}, {0,0,0,0}, {0,0,0,0}, {0,0,0,0}, {0,0,0,0}, {0,0,0,0}, {0,0,0,0}, {0,0,0,0}, {0,0,0,0}, {0,0,0,0}, {0,0,0,0}, {0,255,255,1}, {0,0,0,0}, {120,165,240,17}, {80,130,236,237}, {78,129,241,255}, {77,127,235,254}, {77,127,236,255}, {77,127,236,255}, {77,127,236,255}, {77,127,236,255}, {77,128,236,255}, {76,127,236,255}, {78,132,239,255}, {74,116,230,253}, {61,81,210,252}, {64,123,231,254}, {68,136,241,255}, {68,131,238,255}, {70,131,238,255}, {71,130,237,254}, {73,131,242,255}, {79,132,237,227},
    {0,0,0,0}, {0,0,0,0}, {0,0,0,0}, {0,0,0,0}, {0,0,0,0}, {0,0,0,0}, {0,0,0,0}, {0,0,0,0}, {0,0,0,0}, {0,0,0,0}, {0,0,0,0}, {0,0,0,0}, {0,0,0,0}, {0,0,0,0}, {0,0,0,0}, {0,0,0,0}, {0,0,0,0}, {0,0,0,0}, {0,0,0,0}, {0,0,0,0}, {0,0,0,0}, {0,0,0,0}, {0,0,0,0}, {0,0,0,0}, {0,0,0,0}, {0,0,0,0}, {63,127,191,4}, {0,0,0,1}, {98,132,236,83}, {91,129,248,255}, {86,121,233,252}, {85,122,234,255}, {85,122,234,255}, {85,122,234,255}, {85,122,234,255}, {85,122,234,255}, {85,121,234,255}, {86,126,236,255}, {82,107,225,253}, {69,73,205,254}, {61,71,201,255}, {60,86,206,254}, {77,126,234,254}, {79,127,237,255}, {80,125,236,255}, {81,124,234,254}, {83,126,240,255}, {88,126,234,227},
    {0,0,0,0}, {0,0,0,0}, {0,0,0,0}, {0,0,0,0}, {0,0,0,0}, {0,0,0,0}, {0,0,0,0}, {0,0,0,0}, {0,0,0,0}, {0,0,0,0}, {0,0,0,0}, {0,0,0,0}, {0,0,0,0}, {0,0,0,0}, {0,0,0,0}, {0,0,0,0}, {0,0,0,0}, {0,0,0,0}, {0,0,0,0}, {0,0,0,0}, {0,0,0,0}, {0,0,0,0}, {0,0,0,0}, {0,0,0,0}, {0,0,0,0}, {0,0,0,0}, {85,85,255,3}, {0,0,0,0}, {101,122,233,164}, {100,124,247,254}, {94,116,232,251}, {94,117,232,255}, {94,117,232,255}, {93,117,232,255}, {93,117,232,255}, {93,116,233,255}, {95,121,234,255}, {89,98,221,253}, {75,66,203,254}, {68,70,204,255}, {63,77,205,255}, {54,76,201,255}, {62,95,212,253}, {90,122,235,254}, {89,119,233,255}, {90,118,232,254}, {93,119,238,255}, {98,121,232,227},
    {0,0,0,0}, {0,0,0,0}, {0,0,0,0}, {0,0,0,0}, {0,0,0,0}, {0,0,0,0}, {0,0,0,0}, {0,0,0,0}, {0,0,0,0}, {0,0,0,0}, {0,0,0,0}, {0,0,0,0}, {0,0,0,0}, {0,0,0,0}, {0,0,0,0}, {0,0,0,0}, {0,0,0,0}, {0,0,0,0}, {0,0,0,0}, {0,0,0,0}, {0,0,0,0}, {0,0,0,0}, {0,0,0,0}, {0,0,0,0}, {0,0,0,0}, {0,0,255,1}, {0,0,0,0}, {156,156,235,13}, {106,114,229,233}, {104,114,235,255}, {102,111,229,254}, {102,112,230,255}, {102,112,230,255}, {102,112,230,255}, {102,112,230,255}, {103,115,231,254}, {95,88,218,253}, {82,60,204,255}, {75,67,205,255}, {69,72,204,255}, {62,75,204,255}, {57,79,203,255}, {45,81,200,255}, {73,102,218,252}, {104,116,233,255}, {99,112,229,254}, {104,113,235,255}, {107,115,230,227},
    {0,0,0,0}, {0,0,0,0}, {0,0,0,0}, {0,0,0,0}, {0,0,0,0}, {0,0,0,0}, {0,0,0,0}, {0,0,0,0}, {0,0,0,0}, {0,0,0,0}, {0,0,0,0}, {0,0,0,0}, {0,0,0,0}, {0,0,0,0}, {0,0,0,0}, {0,0,0,0}, {0,0,0,0}, {0,0,0,0}, {0,0,0,0}, {0,0,0,0}, {0,0,0,0}, {0,0,0,0}, {0,0,0,0}, {0,0,0,0}, {0,0,0,0}, {127,63,191,4}, {0,0,0,1}, {122,119,228,77}, {117,113,240,255}, {109,105,227,253}, {111,106,228,255}, {111,106,228,255}, {110,106,228,255}, {111,107,229,255}, {111,109,229,254}, {102,79,216,252}, {88,56,205,255}, {82,64,206,255}, {75,67,205,255}, {69,71,204,255}, {62,75,204,255}, {56,79,203,255}, {49,83,203,255}, {41,86,200,254}, {92,103,221,253}, {114,107,229,254}, {112,107,232,255}, {116,110,229,227},
    {0,0,0,0}, {0,0,0,0}, {0,0,0,0}, {0,0,0,0}, {0,0,0,0}, {0,0,0,0}, {0,0,0,0}, {0,0,0,0}, {0,0,0,0}, {0,0,0,0}, {0,0,0,0}, {0,0,0,0}, {0,0,0,0}, {0,0,0,0}, {0,0,0,0}, {0,0,0,0}, {0,0,0,0}, {0,0,0,0}, {0,0,0,0}, {0,0,0,0}, {0,0,0,0}, {0,0,0,0}, {0,0,0,0}, {0,0,0,0}, {0,0,0,0}, {170,85,255,3}, {0,0,0,0}, {126,107,227,159}, {127,108,241,254}, {118,101,226,251}, {119,102,226,255}, {119,101,226,255}, {119,102,227,255}, {119,102,225,254}, {107,69,214,253}, {94,52,206,255}, {89,60,207,255}, {82,63,206,255}, {75,67,205,255}, {69,71,204,255}, {62,75,204,255}, {56,79,203,255}, {50,83,202,255}, {40,87,201,255}, {42,91,201,254}, {112,101,223,252}, {126,101,231,255}, {124,104,225,227},
    {0,0,0,0}, {0,0,0,0}, {0,0,0,0}, {0,0,0,0}, {0,0,0,0}, {0,0,0,0}, {0,0,0,0}, {0,0,0,0}, {0,0,0,0}, {0,0,0,0}, {0,0,0,0}, {0,0,0,0}, {0,0,0,0}, {0,0,0,0}, {0,0,0,0}, {0,0,0,0}, {0,0,0,0}, {0,0,0,0}, {0,0,0,0}, {0,0,0,0}, {0,0,0,0}, {0,0,0,0}, {0,0,0,0}, {0,0,0,0}, {0,0,255,1}, {0,0,0,0}, {185,139,231,11}, {130,99,223,230}, {130,98,229,255}, {128,96,224,253}, {127,96,224,255}, {128,98,225,255}, {127,95,223,254}, {113,61,212,253}, {100,48,207,255}, {95,57,208,255}, {89,60,206,255}, {82,63,206,255}, {75,67,205,255}, {69,71,204,255}, {62,75,204,255}, {56,79,203,255}, {49,83,202,255}, {44,87,202,255}, {30,91,200,255}, {52,95,205,252}, {135,95,227,255}, {135,98,223,227},
    {0,0,0,0}, {255,0,255,1}, {127,127,127,2}, {255,127,255,2}, {255,170,255,3}, {170,170,255,3}, {0,0,0,0}, {0,0,0,0}, {0,0,0,0}, {0,0,0,0}, {0,0,0,0}, {0,0,0,0}, {0,0,0,0}, {0,0,0,0}, {0,0,0,0}, {0,0,0,0}, {0,0,0,0}, {0,0,0,0}, {0,0,0,0}, {0,0,0,0}, {0,0,0,0}, {0,0,0,0}, {0,0,0,0}, {0,0,0,0}, {170,85,255,3}, {0,0,0,0}, {148,106,223,72}, {144,96,233,255}, {136,90,221,253}, {136,90,222,255}, {138,93,223,255}, {135,86,220,254}, {118,52,210,254}, {107,45,208,255}, {102,53,208,255}, {95,56,207,255}, {89,60,206,255}, {82,63,206,255}, {75,67,205,255}, {69,71,204,255}, {62,75,204,255}, {56,79,203,255}, {49,83,202,255}, {43,87,201,254}, {38,91,201,252}, {20,95,197,250}, {77,95,211,252}, {155,92,224,226},
    {0,0,0,0}, {0,0,0,0}, {0,0,0,0}, {0,0,0,0}, {0,0,0,0}, {0,0,0,0}, {0,0,0,0}, {0,0,0,0}, {0,0,0,0}, {0,0,0,0}, {0,0,0,0}, {0,0,0,0}, {0,0,0,0}, {0,0,0,0}, {0,0,0,0}, {0,0,0,0}, {0,0,0,0}, {0,0,0,0}, {0,0,0,0}, {0,0,0,0}, {0,0,0,0}, {0,0,0,0}, {0,0,0,0}, {0,0,0,0}, {127,63,191,4}, {0,0,0,0}, {150,93,221,153}, {155,92,235,254}, {144,85,220,251}, {146,89,221,255}, {141,80,218,253}, {122,45,210,254}, {114,42,209,255}, {108,49,209,255}, {102,52,208,255}, {95,56,207,255}, {89,60,206,255}, {82,63,206,255}, {75,67,205,254}, {69,71,203,253}, {61,75,204,251}, {55,79,203,251}, {48,82,201,253}, {43,88,205,255}, {37,94,210,255}, {32,101,213,255}, {22,107,216,255}, {96,99,212,228},
    {204,153,255,5}, {255,255,255,5}, {188,151,226,27}, {183,142,229,50}, {189,143,242,82}, {181,138,230,83}, {255,255,255,1}, {0,0,255,1}, {0,0,0,0}, {0,0,0,0}, {0,0,0,0}, {0,0,0,0}, {0,0,0,0}, {0,0,0,0}, {0,0,0,0}, {0,0,0,0}, {0,0,0,0}, {0,0,0,0}, {0,0,0,0}, {0,0,0,0}, {0,0,0,0}, {0,0,0,0}, {0,0,0,0}, {255,0,255,1}, {0,0,0,0}, {198,141,226,9}, {150,88,218,226}, {151,84,225,255}, {151,87,219,253}, {142,74,216,253}, {122,43,209,254}, {120,40,210,255}, {116,45,209,255}, {108,48,209,255}, {102,52,207,254}, {95,56,207,252}, {89,59,206,251}, {81,62,205,252}, {75,67,206,255}, {70,73,211,255}, {65,79,216,255}, {60,85,217,255}, {52,87,209,255}, {48,90,203,239}, {43,96,204,198}, {43,104,206,147}, {42,112,210,91}, {41,124,207,43},
    {183,139,230,124}, {181,134,235,234}, {175,128,228,242}, {176,129,229,255}, {196,142,255,255}, {177,132,228,185}, {0,0,0,0}, {170,170,255,3}, {0,0,0,0}, {0,0,0,0}, {0,0,0,0}, {0,0,0,0}, {0,0,0,0}, {0,0,0,0}, {0,0,0,1}, {0,0,0,0}, {0,0,0,0}, {0,0,0,0}, {0,0,0,0}, {0,0,0,0}, {0,0,0,0}, {0,0,0,0}, {0,0,0,0}, {170,85,255,3}, {0,0,0,0}, {158,104,224,66}, {154,88,228,255}, {149,86,219,253}, {139,71,216,252}, {120,41,210,253}, {119,40,209,253}, {121,41,210,251}, {114,43,209,251}, {107,47,208,254}, {103,52,212,255}, {99,58,218,255}, {95,64,221,255}, {87,68,217,255}, {77,70,206,250}, {74,77,207,215}, {71,83,209,167}, {72,95,211,112}, {68,101,210,63}, {92,127,220,22}, {2,0,0,0}, {0,0,0,0}, {0,0,0,0}, {0,0,0,0},
    {196,137,235,13}, {179,133,230,168}, {191,138,249,255}, {174,126,228,246}, {187,135,243,252}, {179,134,229,131}, {0,0,0,0}, {191,127,255,4}, {0,0,0,0}, {0,0,0,0}, {0,0,0,0}, {0,0,0,0}, {0,0,0,0}, {0,0,255,1}, {0,0,0,0}, {127,127,255,2}, {0,0,0,0}, {0,0,0,0}, {0,0,0,0}, {0,0,0,0}, {0,0,0,0}, {0,0,0,0}, {0,0,0,0}, {127,63,191,4}, {0,0,0,0}, {153,94,220,146}, {160,93,235,251}, {136,65,215,245}, {119,38,209,252}, {121,40,212,255}, {126,42,219,255}, {129,43,224,255}, {123,48,223,255}, {112,51,213,255}, {106,56,210,230}, {102,64,212,186}, {100,71,211,135}, {96,80,211,82}, {106,99,219,36}, {255,255,255,3}, {0,0,0,0}, {0,0,0,0}, {0,0,0,0}, {0,0,0,0}, {0,0,255,1}, {0,63,191,4}, {0,127,191,4}, {127,127,255,2},
    {0,0,0,0}, {0,0,0,0}, {181,134,232,157}, {186,135,242,255}, {185,134,240,253}, {179,135,228,98}, {0,0,0,0}, {191,127,255,4}, {0,0,0,0}, {0,0,0,0}, {0,0,0,0}, {0,0,0,0}, {0,0,0,0}, {0,0,0,0}, {0,0,0,0}, {0,0,0,0}, {170,85,170,3}, {0,0,0,0}, {0,0,0,0}, {0,0,0,0}, {0,0,0,0}, {0,0,0,0}, {85,85,170,3}, {127,63,255,4}, {212,170,255,6}, {150,89,219,227}, {144,66,231,255}, {127,41,223,255}, {127,45,220,255}, {123,45,211,243}, {127,48,213,204}, {127,52,214,156}, {125,58,213,104}, {129,72,216,53}, {163,127,218,14}, {0,0,0,0}, {0,0,0,0}, {0,0,0,0}, {0,0,0,0}, {0,0,0,0}, {0,85,170,3}, {63,63,191,4}, {85,85,170,3}, {0,255,255,1}, {0,0,0,0}, {0,0,0,0}, {0,0,0,0}, {0,0,0,0},
    {255,255,255,1}, {255,127,255,2}, {0,0,0,0}, {181,135,231,149}, {195,142,253,255}, {180,139,230,62}, {127,63,255,4}, {153,153,204,5}, {0,0,0,0}, {0,0,0,0}, {0,0,0,0}, {255,255,255,1}, {127,127,255,2}, {255,204,255,5}, {183,136,234,190}, {177,135,225,79}, {0,0,0,0}, {191,127,255,4}, {0,0,0,0}, {0,0,0,0}, {170,85,170,3}, {127,0,255,2}, {0,0,0,0}, {0,0,0,0}, {165,114,225,60}, {140,69,219,225}, {123,43,211,176}, {131,55,213,124}, {138,65,218,70}, {151,94,226,27}, {0,3,0,0}, {0,0,0,0}, {0,0,0,0}, {0,0,0,0}, {0,0,0,0}, {0,0,255,2}, {63,63,191,4}, {85,85,255,3}, {127,127,255,2}, {0,0,255,1}, {0,0,0,0}, {0,0,0,0}, {0,0,0,0}, {0,0,0,0}, {0,0,0,0}, {0,0,0,0}, {0,0,0,0}, {0,0,0,0},
    {0,0,0,0}, {255,255,255,1}, {127,127,255,2}, {0,0,0,0}, {183,138,231,142}, {197,159,235,40}, {0,0,0,0}, {0,0,0,0}, {127,0,255,2}, {170,85,255,3}, {255,0,255,1}, {191,127,255,4}, {0,0,0,0}, {178,132,225,140}, {192,139,251,255}, {180,131,234,248}, {181,140,231,87}, {0,0,0,0}, {255,0,255,1}, {0,0,0,0}, {0,0,0,0}, {0,0,0,0}, {138,80,218,35}, {136,56,225,136}, {136,64,214,131}, {170,85,255,9}, {0,0,0,0}, {0,0,0,0}, {0,0,0,0}, {0,0,0,0}, {0,0,0,0}, {127,0,191,4}, {127,63,191,4}, {127,127,255,2}, {255,0,255,1}, {0,0,0,0}, {0,0,0,0}, {0,0,0,0}, {0,0,0,0}, {0,0,0,0}, {0,0,0,0}, {0,0,0,0}, {0,0,0,0}, {0,0,0,0}, {0,0,0,0}, {0,0,0,0}, {0,0,0,0}, {0,0,0,0},
    {0,0,0,0}, {0,0,0,0}, {255,255,255,1}, {255,0,255,1}, {0,0,0,0}, {154,95,221,173}, {159,97,230,123}, {165,117,227,37}, {0,0,0,0}, {0,0,0,0}, {0,0,0,0}, {0,0,0,0}, {181,139,227,66}, {183,133,237,255}, {174,125,228,253}, {180,130,235,255}, {190,139,248,255}, {181,134,230,125}, {255,255,255,2}, {170,127,212,6}, {140,66,221,69}, {130,52,216,170}, {123,44,213,243}, {138,47,239,255}, {127,52,212,102}, {0,0,0,0}, {109,36,218,7}, {127,63,191,4}, {170,85,255,3}, {127,0,127,2}, {0,0,0,0}, {0,0,0,0}, {0,0,0,0}, {0,0,0,0}, {0,0,0,0}, {0,0,0,0}, {0,0,0,0}, {0,0,0,0}, {0,0,0,0}, {0,0,0,0}, {0,0,0,0}, {0,0,0,0}, {0,0,0,0}, {0,0,0,0}, {0,0,0,0}, {0,0,0,0}, {0,0,0,0}, {0,0,0,0},
    {0,0,0,0}, {0,0,0,0}, {0,0,0,0}, {127,63,255,4}, {0,0,255,1}, {151,90,219,160}, {169,96,250,255}, {150,87,221,245}, {155,92,225,182}, {160,100,227,94}, {156,107,235,26}, {191,151,231,32}, {180,132,231,238}, {183,134,238,255}, {176,129,228,243}, {177,129,227,226}, {179,131,231,206}, {181,135,231,185}, {175,129,228,77}, {126,50,212,193}, {137,48,237,255}, {128,42,224,255}, {120,39,209,252}, {124,44,215,251}, {139,69,217,55}, {255,0,255,1}, {85,85,170,3}, {0,0,0,0}, {0,0,0,0}, {0,0,0,0}, {0,0,0,0}, {0,0,0,0}, {0,0,0,0}, {0,0,0,0}, {0,0,0,0}, {0,0,0,0}, {0,0,0,0}, {0,0,0,0}, {0,0,0,0}, {0,0,0,0}, {0,0,0,0}, {0,0,0,0}, {0,0,0,0}, {0,0,0,0}, {0,0,0,0}, {0,0,0,0}, {0,0,0,0}, {0,0,0,0},
    {0,0,0,0}, {0,0,0,0}, {0,0,0,0}, {170,85,255,3}, {0,0,0,0}, {158,104,222,71}, {155,88,227,253}, {146,82,217,252}, {159,90,236,255}, {170,97,251,255}, {154,93,223,196}, {181,137,228,76}, {191,143,239,80}, {183,142,224,50}, {182,145,227,28}, {226,198,255,9}, {0,0,0,0}, {0,0,0,0}, {85,85,255,3}, {139,63,214,44}, {131,53,216,144}, {125,46,215,238}, {131,44,228,255}, {123,44,210,246}, {153,102,229,20}, {0,0,0,0}, {255,0,255,1}, {0,0,0,0}, {0,0,0,0}, {0,0,0,0}, {0,0,0,0}, {0,0,0,0}, {0,0,0,0}, {0,0,0,0}, {0,0,0,0}, {0,0,0,0}, {0,0,0,0}, {0,0,0,0}, {0,0,0,0}, {0,0,0,0}, {0,0,0,0}, {0,0,0,0}, {0,0,0,0}, {0,0,0,0}, {0,0,0,0}, {0,0,0,0}, {0,0,0,0}, {0,0,0,0},
    {0,0,0,0}, {0,0,0,0}, {0,0,0,0}, {255,0,255,1}, {0,0,0,0}, {170,136,221,15}, {149,86,219,236}, {158,90,234,255}, {153,89,223,219}, {156,98,224,109}, {165,120,225,17}, {0,0,0,0}, {0,0,0,0}, {0,0,0,0}, {0,0,0,0}, {0,0,0,0}, {0,0,0,0}, {255,127,255,2}, {0,0,0,0}, {0,0,0,0}, {0,0,0,0}, {139,82,222,31}, {131,53,219,143}, {127,52,212,188}, {255,255,255,1}, {0,0,0,0}, {0,0,0,0}, {0,0,0,0}, {0,0,0,0}, {0,0,0,0}, {0,0,0,0}, {0,0,0,0}, {0,0,0,0}, {0,0,0,0}, {0,0,0,0}, {0,0,0,0}, {0,0,0,0}, {0,0,0,0}, {0,0,0,0}, {0,0,0,0}, {0,0,0,0}, {0,0,0,0}, {0,0,0,0}, {0,0,0,0}, {0,0,0,0}, {0,0,0,0}, {0,0,0,0}, {0,0,0,0},
    {0,0,0,0}, {0,0,0,0}, {0,0,0,0}, {0,0,0,0}, {127,0,255,2}, {0,0,0,0}, {154,95,220,163}, {159,98,231,142}, {170,127,212,18}, {0,0,0,0}, {0,0,0,0}, {127,127,255,2}, {170,170,255,3}, {170,85,170,3}, {127,127,255,2}, {255,255,255,1}, {0,0,0,0}, {0,0,0,0}, {0,0,0,0}, {127,0,127,2}, {127,0,191,4}, {0,0,0,0}, {0,0,0,0}, {198,170,255,9}, {0,0,255,1}, {0,0,0,0}, {0,0,0,0}, {0,0,0,0}, {0,0,0,0}, {0,0,0,0}, {0,0,0,0}, {0,0,0,0}, {0,0,0,0}, {0,0,0,0}, {0,0,0,0}, {0,0,0,0}, {0,0,0,0}, {0,0,0,0}, {0,0,0,0}, {0,0,0,0}, {0,0,0,0}, {0,0,0,0}, {0,0,0,0}, {0,0,0,0}, {0,0,0,0}, {0,0,0,0}, {0,0,0,0}, {0,0,0,0},
};

#endif /* ZEPHYR_LOGO_H_ */
```
